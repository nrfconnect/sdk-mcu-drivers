## Kconfig
```kconfig
#
# Copyright (c) 2022 Nordic Semiconductor
#
# SPDX-License-Identifier: LicenseRef-Nordic-5-Clause
#

config HW_CODEC_CIRRUS_LOGIC
    bool "Use the Cirrus Logic drivers for HW codecs."
```
